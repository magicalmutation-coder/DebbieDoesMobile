## firmware/sdkconfig.defaults
```kconfig
# Debbie — ESP-IDF default configuration
# Adjust for your specific hardware variant

# Target
CONFIG_IDF_TARGET="esp32s3"

# Flash
CONFIG_ESPTOOLPY_FLASHSIZE_16MB=y
CONFIG_PARTITION_TABLE_CUSTOM=y
CONFIG_PARTITION_TABLE_CUSTOM_FILENAME="partitions.csv"

# PSRAM (required for camera frame buffers)
CONFIG_SPIRAM=y
CONFIG_SPIRAM_MODE_OCT=y
CONFIG_SPIRAM_SPEED_80M=y
CONFIG_SPIRAM_USE_MALLOC=y
CONFIG_SPIRAM_MALLOC_ALWAYSINTERNAL=16384

# CPU
CONFIG_ESP_DEFAULT_CPU_FREQ_MHZ_240=y

# WiFi
CONFIG_ESP_WIFI_STATIC_RX_BUFFER_NUM=16
CONFIG_ESP_WIFI_DYNAMIC_RX_BUFFER_NUM=64
CONFIG_ESP_WIFI_TX_BUFFER_TYPE_DYNAMIC=y

# ─── Bluetooth (BLE only — ESP32-S3 does not support Classic BT) ─────────────
CONFIG_BT_ENABLED=y
CONFIG_BT_BLE_ENABLED=y
CONFIG_BT_BLUEDROID_ENABLED=y
CONFIG_BT_CLASSIC_ENABLED=n
CONFIG_BT_BLE_42_FEATURES_SUPPORTED=y
CONFIG_BT_BLE_50_FEATURES_SUPPORTED=n
CONFIG_BT_GATTS_ENABLE=y
CONFIG_BT_GATT_MAX_SR_PROFILES=8
CONFIG_BT_GATT_MAX_SR_ATTRIBUTES=100
# Reserve enough heap for BLE stack
CONFIG_BT_CTRL_BLE_MAX_ACT=10
CONFIG_BT_CTRL_BLE_STATIC_ACL_TX_BUF_NB=0

# ─── TLS ──────────────────────────────────────────────────────────────────────
# SECURITY WARNING: The settings below are for development only.
# For production deployments, remove CONFIG_ESP_TLS_INSECURE and
# CONFIG_ESP_TLS_SKIP_SERVER_CERT_VERIFY to enable full certificate validation.
# Without these, the device is vulnerable to man-in-the-middle attacks.
# Development only:
CONFIG_ESP_TLS_INSECURE=y
CONFIG_ESP_TLS_SKIP_SERVER_CERT_VERIFY=y
# CONFIG_MBEDTLS_CERTIFICATE_BUNDLE is not set

# Improve TLS handshake stability for OpenAI websocket/HTTPS by avoiding
# constrained internal mbedTLS allocator.
# CONFIG_MBEDTLS_INTERNAL_MEM_ALLOC is not set
CONFIG_MBEDTLS_DEFAULT_MEM_ALLOC=y
CONFIG_MBEDTLS_DYNAMIC_BUFFER=y

# NVS encryption (disabled for simplicity — enable for production)
CONFIG_NVS_ENCRYPTION=n

# Stack sizes (increase main task to accommodate BLE + WiFi coexistence)
CONFIG_ESP_MAIN_TASK_STACK_SIZE=12288

# Logging
CONFIG_LOG_DEFAULT_LEVEL_INFO=y
CONFIG_LOG_COLORS=y

# FreeRTOS
CONFIG_FREERTOS_HZ=1000
CONFIG_FREERTOS_UNICORE=n

# OTA
CONFIG_OTA_ALLOW_HTTP=y

# ADC (battery monitoring)
CONFIG_ADC_CAL_EFUSE_TP_ENABLE=y

# I2S
CONFIG_I2S_SUPPRESS_DEPRECATE_WARN=y

# HTTP server
CONFIG_HTTPD_MAX_REQ_HDR_LEN=1024
CONFIG_HTTPD_MAX_URI_LEN=512

# Camera
CONFIG_CAMERA_CORE0=n
CONFIG_CAMERA_CORE1=y
```
